VERSION ""

NS_ :

BS_:

BU_: ECU Tester

BO_ 291 ExampleStatus: 8 ECU
 SG_ Speed : 0|16@1+ (0.1,0) [0|6553.5] "km/h" Tester
 SG_ Temperature : 23|16@0- (0.5,-40) [-16424|16343.5] "degC" Tester
